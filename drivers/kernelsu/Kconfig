## drivers/kernelsu/Kconfig
```kconfig
menu "KernelSU"

config KSU
	tristate "KernelSU function support"
	default y
	help
	  Enable kernel-level root privileges on Android System.
	  Requires CONFIG_KPROBES for kernel hooking support.
	  To compile as a module, choose M here: the
	  module will be called kernelsu.

config KSU_DEBUG
	bool "KernelSU debug mode"
	depends on KSU
	default n
	help
	  Enable KernelSU debug mode.

config KSU_DISABLE_MANAGER
	bool "Disable KernelSU manager integration"
	depends on KSU
	default n
	help
	  Disable manager APK detection and manager-specific handling.
	  Root will be used in place of manager-only functionality.

config KSU_DISABLE_POLICY
	bool "Disable KernelSU policy profiles"
	depends on KSU
	default n
	help
	  Disable per-app root/non-root profile customization.
	  Escalation will always use the default full root profile, and
	  non-root handling will follow the global umount policy only.

config KSU_ALLOWLIST_WORKAROUND
	bool "KernelSU allowlist workaround"
	depends on KSU
	default n
	help
	  Enable workaround for broken allowlist save

# For easier extern ifdef handling
config KSU_MANUAL_HOOK
	bool "KernelSU manual hook mode."
	depends on KSU && KSU != m
	default y if !KPROBES
	default n
	help
	  Enable manual hook support.

choice
	prompt "KernelSU dynamic hook mode"
	depends on KSU && !KSU_MANUAL_HOOK
	default KSU_KPROBES_HOOK

config KSU_KPROBES_HOOK
	bool "KernelSU tracepoint+kretprobe hook"
	depends on KRETPROBES && KPROBES && HAVE_SYSCALL_TRACEPOINTS
	help
	  Enable KPROBES, KRETPROBES and TRACEPOINT hook for KernelSU core.
	  This should not be used on kernel below 5.10.

config KSU_SYSCALL_TABLE_HOOK
	bool "KernelSU syscall table patching hook"
	depends on ARM64 || X86_64
	help
	  Patch sys_call_table entries directly to hook syscalls without
	  kprobes or tracepoints. Intended for non-GKI kernels where kprobes
	  are unavailable or non-functional.
	  Requires kernel >= 4.17 (pt_regs-based syscall ABI).

endchoice

menu "KernelSU - SUSFS"

config KSU_SUSFS
	bool "KernelSU addon - SUSFS"
	depends on KSU
	default n
	help
	  Enable SUSFS, the kernel-side path/mount/stat hiding addon.
	  Requires the fs/susfs.c kernel side plus its hooks.

config KSU_SUSFS_SUS_PATH
	bool "Enable to hide suspicious path"
	depends on KSU_SUSFS
	default y
	help
	  Show a fake view for the given paths.

config KSU_SUSFS_SUS_MOUNT
	bool "Enable to hide suspicious mounts"
	depends on KSU_SUSFS
	default y
	help
	  Rearrange the mount ids so non-su processes cannot correlate
	  KernelSU's mounts with their origin.

config KSU_SUSFS_SUS_KSTAT
	bool "Enable to spoof suspicious kstat"
	depends on KSU_SUSFS
	default y
	help
	  Spoof stat/statfs/inotify/maps results for the given paths.

config KSU_SUSFS_TRY_UMOUNT
	bool "Enable to use try_umount"
	depends on KSU_SUSFS
	default y
	help
	  Umount user-defined paths in the target mount namespace
	  before KernelSU's own umount handling runs.

config KSU_SUSFS_SPOOF_UNAME
	bool "Enable to spoof uname"
	depends on KSU_SUSFS
	default y
	help
	  Spoof the kernel release/version reported by uname().

config KSU_SUSFS_ENABLE_LOG
	bool "Enable logging"
	depends on KSU_SUSFS
	default y
	help
	  Allow the manager to toggle SUSFS kernel logging at runtime.

config KSU_SUSFS_HIDE_KSU_SUSFS_SYMBOLS
	bool "Enable to hide KernelSU and SUSFS symbols"
	depends on KSU_SUSFS
	default y
	help
	  Hide all ksu_/susfs_ symbols from /proc/kallsyms.

config KSU_SUSFS_SPOOF_CMDLINE_OR_BOOTCONFIG
	bool "Enable to spoof /proc/cmdline"
	depends on KSU_SUSFS
	default y
	help
	  Spoof /proc/cmdline with a user-supplied string.

config KSU_SUSFS_OPEN_REDIRECT
	bool "Enable to redirect a path to a new path"
	depends on KSU_SUSFS
	default y
	help
	  Redirect reads and readlinks of one path to another.

config KSU_SUSFS_SUS_MAP
	bool "Enable to hide suspicious mappings"
	depends on KSU_SUSFS
	default y
	help
	  Hide suspicious mappings from /proc/self/maps and related
	  interfaces by faking the device and inode of the backing file.

config KSU_SUSFS_SUS_MEMFD
	bool "Enable to hide suspicious memfd"
	depends on KSU_SUSFS
	default n
	help
	  Spoof the name of suspicious memfd files, as reported through
	  /proc/<pid>/fd and the maps interfaces.

endmenu

endmenu
```
